## conf/layer.conf
```bitbake
# We have a conf and classes directory, add to BBPATH
BBPATH .= ":${LAYERDIR}"

# We have recipes-* directories, add to BBFILES
BBFILES += "${LAYERDIR}/recipes-*/*/*.bbappend \
            ${LAYERDIR}/recipes-*/*/*/*.bb \
            ${LAYERDIR}/recipes-*/*/*/*.bbappend \
        "

BBFILE_COLLECTIONS += "vkrzv2l"
BBFILE_PATTERN_vkrzv2l = "^${LAYERDIR}/"
BBFILE_PRIORITY_vkrzv2l = "17"

LAYERDEPENDS_vkrzv2l = "rzv2l"
LAYERSERIES_COMPAT_vkrzv2l = "dunfell"

HOSTTOOLS += "xz"
```

## conf/machine/vkrzv2l.conf
```bitbake
#@TYPE: Machine
#@NAME: Vekatech VKRZV2L machine
#@DESCRIPTION: RZ/V2L platform

OVERRIDES_append = ":vkrzv2l"
SOC_FAMILY = "r9a07g054l"
require conf/machine/include/rzv2l-common.inc
require conf/machine/include/cip-core.inc

DEFAULTTUNE ?= "cortexa55"

TUNE_CONF ?= "conf/machine/include/tune-cortexa55.inc"
require ${TUNE_CONF}

PREFERRED_PROVIDER_virtual/kernel="linux-renesas"

UBOOT_CONFIG ??= "vkrzv2l"
UBOOT_CONFIG[vkrzv2l] = "vkrzv2l_defconfig"
#UBOOT_CONFIG[vkrzv2l] = "vkrzv2l-sf_defconfig"

# flash writer
EXTRA_IMAGEDEPENDS += " flash-writer"

# Supported devicetree
KERNEL_DEVICETREE = " renesas/vkrzv2l.dtb"

KERNEL_DEVICETREE_OVERLAY  = " \
	renesas/overlays/vkrz-cm33.dtbo \
	renesas/overlays/vkrz-csi-imx219.dtbo \
	renesas/overlays/vkrz-dsi-hdmi.dtbo \
	renesas/overlays/vkrz-dsi-av_disp2.dtbo \
	renesas/overlays/vkrz-dsi-vklcd-ee0700.dtbo \
	renesas/overlays/vkrz-dsi-vklcd07.dtbo \
	renesas/overlays/vkrz-exp-pwm0.dtbo \
	renesas/overlays/vkrz-exp-pwm1.dtbo \
	renesas/overlays/vkrz-exp-pwm2.dtbo \
	renesas/overlays/vkrz-exp-riic2.dtbo \
	renesas/overlays/vkrz-exp-rspi1.dtbo \
	renesas/overlays/vkrz-exp-scif2.dtbo \
	renesas/overlays/vkrz-exp-scif2_rts_cts.dtbo \
	renesas/overlays/vkrz-sdhi0-emmc.dtbo \
	renesas/overlays/vkrz-sdhi0-sdhi.dtbo \
"

BSP_SOC = "RZV2L"
BSP_BOARD = "VK-RZ/V2L-v2.0"

#ENABLE_SPD_OPTEE = '1'
#ENABLE_RZ_SCE    = '1'


IMAGE_BOOT_FILES = " \
	bl2_bp-${MACHINE}.srec \
	fip-${MACHINE}.srec \
	Flash_Writer_SCIF_VKRZV2L_DDR4_2GB_1PCS.mot \
"
# generate wic image
IMAGE_FSTYPES_append = " wic wic.bz2"
IMAGE_BOOT_FILES += " Image vkrzv2l.dtb"

# Deploy the uEnv.txt to the /boot directory
WKS_FILE_DEPENDS_append = " uenv"
IMAGE_BOOT_FILES += "uEnv.txt"
IMAGE_BOOT_FILES += "readme.txt"

# Support DTB Overlay files
IMAGE_BOOT_FILES += " overlays/*;overlays/"
#IMAGE_BOOT_FILES += " cm33/*;cm33/"

WKS_DEFAULT_FILE = "image-vkrzv2l-mmc0.wks"
WKS_FILE = "${@oe.utils.conditional("WKS_SUPPORT", "1", "${WKS_DEFAULT_FILE}", "", d)}"

# Ship kernel modules
MACHINE_ESSENTIAL_EXTRA_RRECOMMENDS_append = " kernel-modules"
```
